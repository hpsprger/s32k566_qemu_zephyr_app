## CMakeLists.txt
```
#
# CMakeLists.txt - Zephyr application
#
cmake_minimum_required(VERSION 3.20.0)

find_package(Zephyr REQUIRED HINTS $ENV{ZEPHYR_BASE})

project(s32k566_hello_world)

target_sources(app PRIVATE src/main.c)
```

## west.yml
```
manifest:
  version: "0.13"

  remotes:
    - name: zephyrproject
      url-base: https://github.com/zephyrproject-rtos

  projects:
    - name: zephyr
      remote: zephyrproject
      repo-path: zephyr
      revision: main
      path: zephyr
      clone-depth: 1
      import:
        name-allowlist:
          - hal_nxp
          - cmsis
          - mbedtls

  self:
    path: app
```

## prj.conf
```kconfig
#
# prj.conf - Application configuration
#

# Console / UART
CONFIG_CONSOLE=y
CONFIG_UART_CONSOLE=y
CONFIG_SERIAL=y

# Kernel
CONFIG_NEWLIB_LIBC=n
CONFIG_PRINTK=y

# Reduce footprint
CONFIG_MINIMAL_LIBC=y
CONFIG_SYS_CLOCK_HW_CYCLES_PER_SEC=48000000

# QEMU demo: Zephyr's S32K566 XIP flash starts at 0x08000100, which creates
# an MPU region that is not power-of-two aligned. QEMU's Cortex-M MPU rejects
# it, so disable MPU for the emulated hello-world target.
CONFIG_ARM_MPU=n
CONFIG_MPU=n
```

## src/main.c
```c
/**
 * @file main.c
 * @brief S32K566 Hello World App
 *
 * Prints "Hello World!" every 1 second via UART.
 * Built for Zephyr OS, targets S32K5XXCVB board.
 */

#include <zephyr/kernel.h>

/* Sleep duration: 1 second */
#define SLEEP_MS 1000

void main(void)
{
	printk("S32K566 Hello World App started!\n");
	printk("Board: %s\n", CONFIG_BOARD);
	printk("Build time: %s %s\n\n", __DATE__, __TIME__);

	uint32_t count = 0;
	while (1) {
		printk("Hello World! - count: %u\n", ++count);
		k_msleep(SLEEP_MS);
	}
}
```
